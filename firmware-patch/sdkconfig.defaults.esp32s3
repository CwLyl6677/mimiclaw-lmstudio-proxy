## firmware-patch/sdkconfig.defaults.esp32s3
```kconfig
# MimiClaw - ESP32-S3 Target Configuration
CONFIG_IDF_TARGET="esp32s3"

# Flash 16MB + QIO
CONFIG_ESPTOOLPY_FLASHSIZE_16MB=y
CONFIG_ESPTOOLPY_FLASHMODE_QIO=y

# CPU 240MHz
CONFIG_ESP_DEFAULT_CPU_FREQ_MHZ_240=y

# PSRAM 8MB Octal
CONFIG_SPIRAM=y
CONFIG_SPIRAM_MODE_OCT=y
CONFIG_SPIRAM_SPEED_80M=y
CONFIG_SPIRAM_MALLOC_ALWAYSINTERNAL=2048
CONFIG_SPIRAM_MALLOC_RESERVE_INTERNAL=98304
CONFIG_SPIRAM_MEMTEST=n

# WiFi memory optimization
CONFIG_ESP_WIFI_STATIC_RX_BUFFER_NUM=3
CONFIG_ESP_WIFI_DYNAMIC_RX_BUFFER_NUM=6
CONFIG_ESP_WIFI_RX_BA_WIN=3
CONFIG_LWIP_TCPIP_RECVMBOX_SIZE=16

# TLS: allow skipping server cert verification (needed for local proxy with self-signed cert)
# Without CONFIG_ESP_TLS_INSECURE=y, the child option below has no effect.
CONFIG_ESP_TLS_INSECURE=y
CONFIG_ESP_TLS_SKIP_SERVER_CERT_VERIFY=y

# mbedTLS memory optimization (use PSRAM for TLS buffers)
CONFIG_MBEDTLS_EXTERNAL_MEM_ALLOC=y
CONFIG_MBEDTLS_DYNAMIC_FREE_CONFIG_DATA=y
```
